## CMakeLists.txt
```
cmake_minimum_required(VERSION 3.20.0)

find_package(Zephyr REQUIRED HINTS $ENV{ZEPHYR_BASE})
project(ota_node)

FILE(GLOB app_sources src/*.c)
target_sources(app PRIVATE ${app_sources})
```

## prj.conf
```kconfig
# OTA Node Configuration
CONFIG_LOG_MODE_MINIMAL=y
CONFIG_MAIN_STACK_SIZE=4096

# Enable WiFi
CONFIG_WIFI=y

# Networking config
CONFIG_NETWORKING=y
CONFIG_NET_IPV4=y
CONFIG_NET_IPV6=y
CONFIG_NET_TCP=y
CONFIG_NET_SOCKETS=y

# Get IPv4 address from DHCP
CONFIG_NET_DHCPV4=y

# Enable DNS resolver
CONFIG_DNS_RESOLVER=y
CONFIG_NET_CONFIG_INIT_TIMEOUT=30

# Enable Ethernet (required for WiFi)
CONFIG_NET_L2_ETHERNET=y

# Network debug config
CONFIG_NET_LOG=y

# MCUboot bootloader
CONFIG_BOOTLOADER_MCUBOOT=y

# Flash layout - A/B partitions
CONFIG_MCUBOOT_FLASH_LAYOUT_DEFAULT=y
CONFIG_MCUBOOT_VALIDATE_SLOT0=y

# Network timeout
CONFIG_NET_WORKQ_STACK_SIZE=4096

# System settings
CONFIG_REBOOT=y
CONFIG_SYSTEM_WORKQUEUE_STACK_SIZE=2048
```

## src/main.c
```c
#include <stdio.h>
#include <string.h>
#include <zephyr/kernel.h>
#include <zephyr/sys/printk.h>

#include "ota.h"

// WiFi credentials
#define WIFI_SSID     "Zero"
#define WIFI_PSK      "abcdefgh"

// ======================================================
// USER SENSOR CODE SECTION
// ======================================================
// Add your sensor code here!
// 
// Step 1: Initialize your sensor in sensor_init()
// Step 2: Read sensor data in sensor_read()
// Step 3: Process data in the main loop
// 
// Example sensor functions:
// 
// void sensor_init(void) {
//     printk("Initializing sensor...\n");
//     // Your sensor initialization code
//     my_sensor_setup();
// }
// 
// void sensor_read(void) {
//     // Read sensor data
//     float value = my_sensor_read_value();
//     printk("Sensor value: %.2f\n", value);
//     // Send to Hub or process
// }
// 
// ======================================================

// Placeholder for sensor initialization
// Replace this with your sensor init code
void sensor_init(void)
{
    printk("[SENSOR] Placeholder: sensor_init() called\n");
    // TODO: Add your sensor initialization here
    // Examples:
    // - I2C sensor: i2c_init();
    // - ADC: adc_channel_setup();
    // - GPIO: gpio_pin_configure();
}

// Placeholder for reading sensor data
// Replace this with your sensor reading code
void sensor_read(void)
{
    printk("[SENSOR] Placeholder: sensor_read() called\n");
    // TODO: Add your sensor reading code here
    // Examples:
    // - Read I2C: i2c_reg_read(SENSOR_ADDR, REG_DATA);
    // - Read ADC: adc_read(ADC_CHANNEL);
    // - Read GPIO: gpio_pin_get();
}

// Process sensor data (optional)
// Add data processing, filtering, or sending to Hub here
void sensor_process(void)
{
    // TODO: Add your processing code here
    // Examples:
    // - Apply calibration
    // - Filter data
    // - Send to Hub via network
}

// ======================================================
// MAIN APPLICATION
// ======================================================

void main(void)
{
    printk("===========================================\n");
    printk("  ESP32 OTA Node starting...\n");
    printk("  Node ID: %s\n", NODE_ID);
    printk("  Firmware: %s\n", FIRMWARE_VERSION);
    printk("===========================================\n\n");

    // Initialize WiFi
    printk("Initializing WiFi...\n");
    wifi_init();

    // Connect to WiFi
    printk("Connecting to WiFi '%s'...\n", WIFI_SSID);
    int ret = wifi_connect(WIFI_SSID, WIFI_PSK);
    if (ret < 0) {
        printk("ERROR: WiFi connection failed (%d)\n", ret);
        return;
    }

    // Wait for IP address
    printk("Waiting for IP address...\n");
    wifi_wait_for_ip_addr();
    printk("WiFi connected!\n\n");

    // Initialize OTA
    printk("Initializing OTA client...\n");
    ota_init();

    // Initialize USER sensor
    printk("Initializing user sensor...\n");
    sensor_init();

    // Initial check
    printk("\n--- Checking for firmware updates ---\n");
    ota_poll_server();

    printk("\n--- OTA check complete ---\n\n");

    // Main loop - runs sensor + checks for OTA updates
    while (1) {
        // Read sensor data
        sensor_read();
        
        // Optional: process sensor data
        sensor_process();
        
        // Sleep interval (adjust for your sensor needs)
        // Default: 10 seconds. Change to K_MINUTES(X) for minutes
        printk("Sleeping for 10 seconds...\n");
        k_sleep(K_SECONDS(10));
        
        // Periodically check for OTA updates (every 5 minutes)
        static int loop_count = 0;
        loop_count++;
        if (loop_count >= 30) {  // 30 * 10 seconds = 5 minutes
            loop_count = 0;
            printk("Checking for OTA updates...\n");
            ota_poll_server();
        }
    }
}
```

## src/ota.c
```c
#include <stdio.h>
#include <string.h>
#include <errno.h>
#include <zephyr/kernel.h>
#include <zephyr/net/socket.h>
#include <zephyr/net/net_ip.h>
#include <zephyr/net/net_context.h>
#include <zephyr/sys/printk.h>
#include <zephyr/device.h>
#include <zephyr/drivers/flash.h>
#include "ota.h"

// External WiFi functions
extern void wifi_init(void);
extern int wifi_connect(char *ssid, char *psk);
extern void wifi_wait_for_ip_addr(void);

// Static variables
static struct ota_state ota_state = {
    .state = OTA_STATE_IDLE,
    .update_available = 0,
    .firmware_url[0] = '\0',
    .firmware_version[0] = '\0',
    .firmware_size = 0,
    .downloaded_size = 0
};

static const struct device *flash_dev;

// HTTP GET request
static int http_get(const char *host, const char *path, char *response, size_t resp_size)
{
    struct zsock_addrinfo hints, *res;
    int sock, ret;
    char request[256];
    char buf[512];
    int bytes_received;

    // Setup hints
    memset(&hints, 0, sizeof(hints));
    hints.ai_family = AF_INET;
    hints.ai_socktype = SOCK_STREAM;

    // DNS lookup
    ret = zsock_getaddrinfo(host, "5000", &hints, &res);
    if (ret != 0) {
        printk("OTA: DNS lookup failed for %s\n", host);
        return -EIO;
    }

    // Create socket
    sock = zsock_socket(res->ai_family, res->ai_socktype, res->ai_protocol);
    if (sock < 0) {
        printk("OTA: Socket creation failed\n");
        return -EIO;
    }

    // Connect
    ret = zsock_connect(sock, res->ai_addr, res->ai_addrlen);
    if (ret < 0) {
        printk("OTA: Connect failed\n");
        zsock_close(sock);
        return -EIO;
    }

    // Build HTTP GET
    snprintf(request, sizeof(request),
        "GET %s HTTP/1.1\r\n"
        "Host: %s\r\n"
        "Connection: close\r\n"
        "\r\n",
        path, host);

    // Send request
    ret = zsock_send(sock, request, strlen(request), 0);
    if (ret < 0) {
        printk("OTA: Send failed\n");
        zsock_close(sock);
        return -EIO;
    }

    // Receive response
    bytes_received = zsock_recv(sock, response, resp_size - 1, 0);
    if (bytes_received < 0) {
        printk("OTA: Receive failed\n");
        zsock_close(sock);
        return -EIO;
    }

    response[bytes_received] = '\0';
    zsock_close(sock);

    return 0;
}

// HTTP download (chunked)
static int http_download_chunk(const char *host, const char *path, 
                             uint8_t *buffer, size_t max_size, size_t *received)
{
    struct zsock_addrinfo hints, *res;
    int sock, ret;
    char request[256];
    char buf[CHUNK_SIZE];
    size_t total = 0;

    // Setup hints
    memset(&hints, 0, sizeof(hints));
    hints.ai_family = AF_INET;
    hints.ai_socktype = SOCK_STREAM;

    // DNS lookup
    ret = zsock_getaddrinfo(host, "5000", &hints, &res);
    if (ret != 0) {
        return -EIO;
    }

    // Create socket
    sock = zsock_socket(res->ai_family, res->ai_socktype, res->ai_protocol);
    if (sock < 0) {
        return -EIO;
    }

    // Connect
    ret = zsock_connect(sock, res->ai_addr, res->ai_addrlen);
    if (ret < 0) {
        zsock_close(sock);
        return -EIO;
    }

    // Build HTTP GET
    snprintf(request, sizeof(request),
        "GET %s HTTP/1.1\r\n"
        "Host: %s\r\n"
        "Connection: close\r\n"
        "\r\n",
        path, host);

    // Send request
    zsock_send(sock, request, strlen(request), 0);

    // Skip HTTP headers, find body start
    int header_found = 0;
    size_t body_start = 0;
    
    while (total < max_size) {
        ret = zsock_recv(sock, buf, CHUNK_SIZE, 0);
        if (ret <= 0) break;

        if (!header_found) {
            // Find \r\n\r\n (end of headers)
            for (int i = 0; i < ret - 3; i++) {
                if (buf[i] == '\r' && buf[i+1] == '\n' && 
                    buf[i+2] == '\r' && buf[i+3] == '\n') {
                    header_found = 1;
                    body_start = i + 4;
                    break;
                }
            }
        }

        if (header_found) {
            size_t to_copy = ret - body_start;
            if (total + to_copy > max_size) {
                to_copy = max_size - total;
            }
            memcpy(buffer + total, buf + body_start, to_copy);
            total += to_copy;
            body_start = 0;
        }
    }

    zsock_close(sock);
    *received = total;
    return 0;
}

// Initialize OTA
void ota_init(void)
{
    printk("OTA: Initializing OTA client\n");
    flash_dev = DEVICE_DT_GET(DT_CHOSEN(zephyr_flash));
    if (!flash_dev) {
        printk("OTA: ERROR - Flash device not found\n");
    } else {
        printk("OTA: Flash device ready\n");
    }
    ota_state.state = OTA_STATE_IDLE;
}

// Check for updates
int ota_check_for_update(void)
{
    char response[HTTP_RESP_SIZE];
    char path[128];
    int ret;

    printk("OTA: Checking for updates...\n");

    // Build API path
    snprintf(path, sizeof(path), 
        "/api/nodes?id=%s&version=%s", 
        NODE_ID, FIRMWARE_VERSION);

    // Make request
    ret = http_get(OTA_SERVER_HOST, path, response, sizeof(response));
    if (ret < 0) {
        printk("OTA: Check failed\n");
        return -EIO;
    }

    // Simple parsing (look for "update_available":true)
    if (strstr(response, "update_available\":true") != NULL) {
        printk("OTA: Update available!\n");
        ota_state.update_available = 1;
        
        // Extract URL (simple method)
        char *url_start = strstr(response, "firmware_url\":");
        if (url_start) {
            url_start += 14;  // skip "firmware_url":"
            char *url_end = strchr(url_start, '"');
            if (url_end) {
                *url_end = '\0';
                strncpy(ota_state.firmware_url, url_start, sizeof(ota_state.firmware_url) - 1);
            }
        }
        return 0;
    }

    printk("OTA: No updates available\n");
    ota_state.update_available = 0;
    return 0;
}

// Download and flash firmware
int ota_download_and_flash(void)
{
    uint8_t buffer[CHUNK_SIZE];
    size_t received;
    uint32_t offset = SLOT1_BASE;
    int ret;

    if (!ota_state.update_available) {
        printk("OTA: No update to download\n");
        return -EINVAL;
    }

    printk("OTA: Downloading firmware from %s\n", ota_state.firmware_url);
    ota_state.state = OTA_STATE_DOWNLOADING;

    // Download to flash (chunk by chunk)
    while (1) {
        ret = http_download_chunk(OTA_SERVER_HOST, ota_state.firmware_url,
                             buffer, CHUNK_SIZE, &received);
        if (ret < 0 || received == 0) {
            break;
        }

        // Write to flash (Slot 1)
        if (flash_dev) {
            // Note: In real implementation, need to erase sector first
            // flash_erase(flash_dev, offset, SECTOR_SIZE);
            // flash_write(flash_dev, offset, buffer, received);
        }
        
        offset += received;
        ota_state.downloaded_size += received;
        
        printk("OTA: Written %u bytes\r", ota_state.downloaded_size);
    }

    printk("\nOTA: Download complete (%u bytes)\n", ota_state.downloaded_size);
    ota_state.state = OTA_STATE_IDLE;

    return 0;
}

// Reboot into new slot
void ota_reboot_to_new_slot(void)
{
    printk("OTA: Rebooting into new slot...\n");
    ota_state.state = OTA_STATE_REBOOTING;
    
    sys_reboot(SYS_REBOOT_COLD);
}

// Confirm update (tell server)
int ota_confirm_update(void)
{
    char response[HTTP_RESP_SIZE];
    char path[128];
    
    snprintf(path, sizeof(path),
        "/api/confirm?id=%s&version=%s",
        NODE_ID, FIRMWARE_VERSION);

    http_get(OTA_SERVER_HOST, path, response, sizeof(response));
    
    printk("OTA: Update confirmed\n");
    ota_state.state = OTA_STATE_CONFIRMED;
    
    return 0;
}

// Main poll (call this periodically)
void ota_poll_server(void)
{
    int ret;

    // Check for updates
    ret = ota_check_for_update();
    if (ret == 0 && ota_state.update_available) {
        // Download new firmware
        ret = ota_download_and_flash();
        if (ret == 0) {
            // Reboot
            k_sleep(K_SECONDS(2));
            ota_reboot_to_new_slot();
        }
    }
}
```

## src/ota.h
```c
#ifndef OTA_H
#define OTA_H

#include <zephyr/kernel.h>

// OTA Server Configuration
#define OTA_SERVER_HOST     "raspberrypi.local"
#define OTA_SERVER_PORT     5000
#define OTA_POLL_INTERVAL  300000  // 5 minutes in ms

// Node Configuration
#define NODE_ID            "node-001"
#define FIRMWARE_VERSION   "1.0.0"

// Flash partitions (must match overlay)
#define SLOT0_BASE        0x10000
#define SLOT1_BASE        0x1B0000
#define SLOT_SIZE         0x1A0000

// HTTP buffers
#define HTTP_RESP_SIZE   4096
#define CHUNK_SIZE       1024

// OTA States
#define OTA_STATE_IDLE        0
#define OTA_STATE_CHECKING    1
#define OTA_STATE_DOWNLOADING  2
#define OTA_STATE_WRITING    3
#define OTA_STATE_REBOOTING  4
#define OTA_STATE_CONFIRMED  5

// Structures
struct ota_state {
    uint8_t state;
    uint8_t update_available;
    char firmware_url[128];
    char firmware_version[32];
    uint32_t firmware_size;
    uint32_t downloaded_size;
};

// Function prototypes
void ota_init(void);
void ota_poll_server(void);
int ota_check_for_update(void);
int ota_download_and_flash(void);
void ota_reboot_to_new_slot(void);
int ota_confirm_update(void);

// WiFi functions (from wifi.c)
void wifi_init(void);
int wifi_connect(char *ssid, char *psk);
void wifi_wait_for_ip_addr(void);

// HTTP client functions
int http_get(const char *host, const char *path, char *response, size_t resp_size);
int http_download(const char *host, const char *path, uint8_t *buffer, size_t size);

#endif  // OTA_H
```

## src/sensor.c
```c
#include "sensor.h"

// This file is intentionally minimal.
// Your sensor implementation goes here.

// See sensor.h for examples and templates.

void sensor_init(void)
{
    // Placeholder - replace with your sensor init
    // Examples:
    // - I2C: i2c_configure();
    // - ADC: adc_channel_setup();
    // - GPIO: gpio_pin_configure();
}

void sensor_read(void)
{
    // Placeholder - replace with your sensor read
    // Examples:
    // - I2C: int value = i2c_reg_read();
    // - ADC: int raw = adc_read();
    // - GPIO: int state = gpio_pin_get();
    
    // Print placeholder message
    printk("[SENSOR] Reading sensor data...\n");
}

void sensor_process(void)
{
    // Placeholder - add data processing if needed
    // Examples:
    // - Apply calibration
    // - Filter noise
    // - Send to Hub via network
}
```

## src/sensor.h
```c
#ifndef SENSOR_H
#define SENSOR_H

#include <zephyr/kernel.h>

// ======================================================
// SENSOR CONFIGURATION
// ======================================================
// Configure your sensor settings here
// ======================================================

// Sensor reading interval (in seconds)
#define SENSOR_READ_INTERVAL  10

// Whether to send sensor data to Hub
#define SENSOR_SEND_TO_HUB  1

// ======================================================
// SENSOR FUNCTIONS
// ======================================================

// Initialize sensor hardware
// Call this once at startup
void sensor_init(void);

// Read current sensor value(s)
// Call this periodically in main loop
void sensor_read(void);

// Process and handle sensor data
// Optional: filtering, calibration, sending to Hub
void sensor_process(void);

// ======================================================
// CUSTOM SENSOR IMPLEMENTATION
// ======================================================
// Add your sensor-specific functions below:
//
// Example for I2C sensor:
// -------------------
// #include <zephyr/drivers/i2c.h>
//
// #define SENSOR_I2C_ADDR  0x68
//
// static const struct device *i2c_dev;
//
// void sensor_init(void) {
//     i2c_dev = device_get_binding("I2C_0");
//     // Configure sensor
// }
//
// float sensor_read_temperature(void) {
//     uint8_t reg = TEMP_REG;
//     uint8_t data[2];
//     i2c_reg_read(i2c_dev, SENSOR_I2C_ADDR, reg, data, 2);
//     return convert_to_celsius(data);
// }
// -------------------
//
// Example for ADC:
// -------------------
// #include <zephyr/drivers/adc.h>
//
// #define ADC_CHANNEL  0
//
// void sensor_read_adc(void) {
//     int16_t raw;
//     adc_read(ADC_CHANNEL, &raw);
//     float voltage = raw * 3.3 / 4096;
// }
// -------------------
//
// Example for GPIO input:
// -------------------
// #include <zephyr/drivers/gpio.h>
//
// void sensor_read_button(void) {
//     int value;
//     gpio_pin_get(button_dev, BUTTON_PIN, &value);
// }
// -------------------

#endif  // SENSOR_H
```
